## aa_wireless_dongle/configs/raspberrypi3a_defconfig
```kconfig
BR2_arm=y
BR2_cortex_a53=y
BR2_ARM_FPU_NEON_VFPV4=y

BR2_TOOLCHAIN_BUILDROOT_CXX=y

# Linux headers same as kernel, a 6.1 series
BR2_PACKAGE_HOST_LINUX_HEADERS_CUSTOM_6_6=y

# Kernel config
BR2_LINUX_KERNEL=y
BR2_LINUX_KERNEL_CUSTOM_TARBALL=y
BR2_LINUX_KERNEL_CUSTOM_TARBALL_LOCATION="$(call github,raspberrypi,linux,576cc10e1ed50a9eacffc7a05c796051d7343ea4)/linux-576cc10e1ed50a9eacffc7a05c796051d7343ea4.tar.gz"
BR2_LINUX_KERNEL_DEFCONFIG="bcm2709"
BR2_LINUX_KERNEL_CONFIG_FRAGMENT_FILES="$(BR2_EXTERNAL_AA_WIRELESS_DONGLE_PATH)/board/common/kernel.config"
BR2_LINUX_KERNEL_LZ4=y
BR2_LINUX_KERNEL_NEEDS_HOST_OPENSSL=y

# Build the DTB from the kernel sources
BR2_LINUX_KERNEL_DTS_SUPPORT=y
BR2_LINUX_KERNEL_INTREE_DTS_NAME="broadcom/bcm2710-rpi-3-b broadcom/bcm2710-rpi-3-b-plus broadcom/bcm2710-rpi-cm3"

# Rootfs overlay
BR2_ROOTFS_OVERLAY="$(BR2_EXTERNAL_AA_WIRELESS_DONGLE_PATH)/board/common/rootfs_overlay $(BR2_EXTERNAL_AA_WIRELESS_DONGLE_PATH)/board/raspberrypi/rootfs_overlay $(BR2_EXTERNAL_AA_WIRELESS_DONGLE_PATH)/board/raspberrypi4/rootfs_overlay"
BR2_GLOBAL_PATCH_DIR="board/raspberrypi/patches $(BR2_EXTERNAL_AA_WIRELESS_DONGLE_PATH)/patches"
BR2_DOWNLOAD_FORCE_CHECK_HASHES=y

# Enable compressed kernel module support
BR2_PACKAGE_BUSYBOX_SHOW_OTHERS=y
BR2_PACKAGE_KMOD=y
BR2_PACKAGE_KMOD_TOOLS=y
BR2_PACKAGE_XZ=y
BR2_PACKAGE_HOST_KMOD_XZ=y

# Firmware
BR2_PACKAGE_RPI_FIRMWARE=y
BR2_PACKAGE_RPI_FIRMWARE_BOOTCODE_BIN=y
BR2_PACKAGE_RPI_FIRMWARE_VARIANT_PI=y
BR2_PACKAGE_RPI_FIRMWARE_CONFIG_FILE="$(BR2_EXTERNAL_AA_WIRELESS_DONGLE_PATH)/board/raspberrypi/config.txt"
BR2_PACKAGE_RPI_FIRMWARE_CMDLINE_FILE="$(BR2_EXTERNAL_AA_WIRELESS_DONGLE_PATH)/board/raspberrypi/cmdline.txt"

# Wifi and Bluetooth firmware
BR2_PACKAGE_BRCMFMAC_SDIO_FIRMWARE_RPI_CUSTOM=y
BR2_PACKAGE_BRCMFMAC_SDIO_FIRMWARE_RPI_CUSTOM_BT=y
BR2_PACKAGE_BRCMFMAC_SDIO_FIRMWARE_RPI_CUSTOM_WIFI=y

# Required tools to create the SD image
BR2_PACKAGE_HOST_DOSFSTOOLS=y
BR2_PACKAGE_HOST_GENIMAGE=y
BR2_PACKAGE_HOST_MTOOLS=y

# Packages to bundle
BR2_PACKAGE_NANO=y
BR2_PACKAGE_RNG_TOOLS=y
BR2_PACKAGE_HAVEGED=y
BR2_PACKAGE_BLUEZ_TOOLS=y
BR2_PACKAGE_BLUEZ5_UTILS=y
BR2_PACKAGE_BLUEZ5_UTILS_CLIENT=y
BR2_PACKAGE_BLUEZ5_UTILS_TOOLS=y
BR2_PACKAGE_DNSMASQ=y
BR2_PACKAGE_DROPBEAR=y
BR2_PACKAGE_HOSTAPD=y
BR2_PACKAGE_WIRELESS_REGDB=y
BR2_PACKAGE_IW=y
BR2_PACKAGE_WPA_SUPPLICANT=y
BR2_PACKAGE_UTIL_LINUX=y
BR2_PACKAGE_UTIL_LINUX_RFKILL=y
BR2_PACKAGE_UMTPRD=y
BR2_PACKAGE_AAWG=y

# Other options
BR2_TARGET_GENERIC_ROOT_PASSWD="password"
# BR2_TARGET_GENERIC_GETTY is not set

# Filesystem / image
BR2_TARGET_GENERIC_REMOUNT_ROOTFS_RW=n
BR2_TARGET_ROOTFS_EXT2=y
BR2_TARGET_ROOTFS_EXT2_4=y
BR2_TARGET_ROOTFS_EXT2_SIZE="80M"
# BR2_TARGET_ROOTFS_TAR is not set
BR2_ROOTFS_POST_BUILD_SCRIPT="$(BR2_EXTERNAL_AA_WIRELESS_DONGLE_PATH)/board/raspberrypi/post-build.sh"
BR2_ROOTFS_POST_IMAGE_SCRIPT="$(BR2_EXTERNAL_AA_WIRELESS_DONGLE_PATH)/board/raspberrypi/post-image.sh"
```

## aa_wireless_dongle/package/Config.in
```kconfig
menu "Packages"
    source "$BR2_EXTERNAL_AA_WIRELESS_DONGLE_PATH/package/aawg/Config.in"
    source "$BR2_EXTERNAL_AA_WIRELESS_DONGLE_PATH/package/dbus-cxx-custom/Config.in"
endmenu
```

## aa_wireless_dongle/package/aawg/Config.in
```kconfig
config BR2_PACKAGE_AAWG
	bool "aawg"
	depends on BR2_INSTALL_LIBSTDCPP
	depends on BR2_TOOLCHAIN_HAS_THREADS
	select BR2_PACKAGE_DBUS_CXX
	select BR2_PACKAGE_PROTOBUF
	help
	  Android Auto Wireless Gateway Daemon
```

## aa_wireless_dongle/package/brcmfmac_sdio-firmware-rpi-custom/Config.in
```kconfig
config BR2_PACKAGE_BRCMFMAC_SDIO_FIRMWARE_RPI_CUSTOM
	bool "brcmfmac-sdio-firmware-rpi-custom"
	help
	  Raspberry Broadcom Bluetooth and Wifi firmware.

	  https://github.com/LibreELEC/brcmfmac_sdio-firmware-rpi

if BR2_PACKAGE_BRCMFMAC_SDIO_FIRMWARE_RPI_CUSTOM

config BR2_PACKAGE_BRCMFMAC_SDIO_FIRMWARE_RPI_CUSTOM_BT
	bool "brcmfmac-sdio-firmware-rpi-bt"
	help
	  Raspberry Pi 3 and Zero W Broadcom BCM43438 Bluetooth module
	  firmware. Raspberry Pi 3 Model B+ Broadcom BCM4345C0
	  Bluetooth module firmware.

config BR2_PACKAGE_BRCMFMAC_SDIO_FIRMWARE_RPI_CUSTOM_WIFI
	bool "brcmfmac-sdio-firmware-rpi-wifi"
	depends on !BR2_PACKAGE_LINUX_FIRMWARE_BRCM_BCM43XXX
	help
	  Raspberry Pi 3 and Zero W Broadcom BCM43430 wifi module
	  NVRAM data. Raspberry Pi 3 Model B+ Broadcom BCM43455
	  wifi module NVRAM data.

comment "brcmfmac-sdio-firmware-rpi-wifi conflicts with linux-firmware Broadcom BRCM bcm43xx"
	depends on BR2_PACKAGE_LINUX_FIRMWARE_BRCM_BCM43XXX

endif
```

## aa_wireless_dongle/package/civetweb/Config.in
```kconfig
config BR2_PACKAGE_CIVETWEB
    bool "civetweb"
    help
      A simple, embeddable web server.

      https://github.com/civetweb/civetweb
```

## aa_wireless_dongle/package/python-pydbus/Config.in
```kconfig
config BR2_PACKAGE_PYTHON_PYDBUS
	bool "python-pydbus"
	select BR2_PACKAGE_PYTHON_GOBJECT
	help
	  Pythonic DBus library.

	  https://github.com/LEW21/pydbus
```
